// SPDX-License-Identifier: GPL-2.0-or-later OR MIT

#include "mt7981_jcg_q30-pro.dtsi"

/ {
	compatible = "jcg,q30-pro-512m", "mediatek,mt7981";
	model = "JCG Q30 PRO";

	memory@40000000 {
		reg = <0x40000000 0x20000000>;
		device_type = "memory";
	};
};
