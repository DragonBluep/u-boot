// SPDX-License-Identifier: GPL-2.0
/*
 * Copyright (C) 2020 MediaTek Inc.
 *
 * Author: Weijie Gao <weijie.gao@mediatek.com>
 */

&uartlite {
	bootph-all;
};

#ifndef CONFIG_BOARD_MT7620_GENERIC
&uartfull {
	bootph-all;
};
#endif
