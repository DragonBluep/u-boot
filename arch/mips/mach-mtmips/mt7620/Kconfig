## arch/mips/mach-mtmips/mt7620/Kconfig
```kconfig
if SOC_MT7620

config DEBUG_UART_BOARD_INIT
	default y

choice
	prompt "Board select"

config BOARD_MT7620_RFB
	bool "MediaTek MT7620 RFB"
	help
	  The reference design of MT7620A (WS2120). The board has 64 MiB DDR2,
	  8 MiB SPI-NOR flash, 1 built-in 6 port switch (two GE PHYs and five
	  FE PHYs,one port can be configured to use either FE PHY or GE PHY),
	  1 UART, 1 USB host, 1 SDXC, 1 PCIe socket and JTAG pins.

config BOARD_MT7620_MT7530_RFB
	bool "MediaTek MT7620-MT7530 RFB"
	help
	  The reference design of MT7620DA (MTKC712). The board has 64 MiB
	  intergrated DDR2 KGD, 16 MiB SPI-NOR flash, an external 5-port giga
	  switch MT7530 and 1 UART.

config BOARD_DOMYWIFI_DM203
	bool "DomyWifi DM203 Wireless Router"

config BOARD_FOCUSMEDIA_MT7620A
	bool "FocusMedia MT7620A Wireless Router"

config BOARD_GBCOM_N3000
	bool "GBCOM N3000-06 Wireless Router"

config BOARD_HAIER_HWL1W
	bool "Haier HW-L1W Wireless Router"

config BOARD_HIWIFI_HC5661
	bool "HiWiFi HC5661 Wireless Router"

config BOARD_HIWIFI_HC5861
	bool "HiWiFi HC5861 Wireless Router"

config BOARD_LBLINK_BLW1210
	bool "LB-Link BL-W1210 Wireless Router"

config BOARD_PHICOMM_K2
	bool "Phicomm K2 Wireless Router"

config BOARD_PHICOMM_K2G
	bool "Phicomm K2G Wireless Router"

config BOARD_YOUKU_X2
	bool "Youku X2 Wireless Router"

config BOARD_YOUKU_YKL1C
	bool "Youku YK-L1c Wireless Router"

endchoice

choice
	prompt "CPU frequency select"
	default CPU_FREQ_580MHZ

config CPU_FREQ_480MHZ
	bool "480MHz"

config CPU_FREQ_500MHZ
	bool "500MHz"

config CPU_FREQ_520MHZ
	bool "520MHz"

config CPU_FREQ_540MHZ
	bool "540MHz"

config CPU_FREQ_560MHZ
	bool "560MHz"

config CPU_FREQ_580MHZ
	bool "580MHz"

config CPU_FREQ_600MHZ
	bool "600MHz"

config CPU_FREQ_620MHZ
	bool "620MHz"

endchoice

config CPU_FREQ_MULTI
	int
	range 0 7
	default 0 if CPU_FREQ_480MHZ
	default 1 if CPU_FREQ_500MHZ
	default 2 if CPU_FREQ_520MHZ
	default 3 if CPU_FREQ_540MHZ
	default 4 if CPU_FREQ_560MHZ
	default 5 if CPU_FREQ_580MHZ
	default 6 if CPU_FREQ_600MHZ
	default 7 if CPU_FREQ_620MHZ

config SYS_CONFIG_NAME
	default "mt7620"

config SYS_BOARD
	string "Board name"
	default "mt7620"

config SYS_VENDOR
	default "mediatek"

endif
```

## configs/mt7620_phicomm_k2_defconfig
```kconfig
CONFIG_MIPS=y
CONFIG_SKIP_LOWLEVEL_INIT=y
CONFIG_SYS_MALLOC_LEN=0x100000
CONFIG_SPL_LIBCOMMON_SUPPORT=y
CONFIG_SPL_LIBGENERIC_SUPPORT=y
CONFIG_NR_DRAM_BANKS=1
CONFIG_ENV_SIZE=0x1000
CONFIG_ENV_OFFSET=0x2f000
CONFIG_ENV_SECT_SIZE=0x1000
CONFIG_DEFAULT_DEVICE_TREE="mt7620_phicomm_k2"
CONFIG_SPL_SERIAL=y
CONFIG_SPL_SYS_MALLOC_F_LEN=0x40000
CONFIG_SPL_BSS_START_ADDR=0x80010000
CONFIG_SPL_BSS_MAX_SIZE=0x10000
CONFIG_SYS_BOOTM_LEN=0x02000000
CONFIG_SYS_LOAD_ADDR=0x82000000
CONFIG_SPL=y
CONFIG_DEBUG_UART_BASE=0xb0000c00
CONFIG_DEBUG_UART_CLOCK=40000000
CONFIG_ARCH_MTMIPS=y
CONFIG_BOARD_MT7620_GENERIC=y
CONFIG_SYS_MIPS_TIMER_FREQ=290000000
CONFIG_MIPS_CACHE_SETUP=y
CONFIG_MIPS_CACHE_DISABLE=y
CONFIG_RESTORE_EXCEPTION_VECTOR_BASE=y
CONFIG_MIPS_BOOT_FDT=y
CONFIG_DEBUG_UART=y
# CONFIG_LOCALVERSION_AUTO is not set
CONFIG_STACK_SIZE=0x100000
CONFIG_TIMESTAMP=y
CONFIG_BUTTON_BOOTSTRAP=y
CONFIG_FIT=y
CONFIG_BOOTDELAY=1
CONFIG_AUTOBOOT_MENU_SHOW=y
# CONFIG_ARCH_FIXUP_FDT_MEMORY is not set
CONFIG_SYS_MALLOC_BOOTPARAMS=y
CONFIG_SPL_MAX_SIZE=0x10000
CONFIG_SPL_SYS_MALLOC_SIMPLE=y
CONFIG_SPL_NOR_SUPPORT=y
CONFIG_HUSH_PARSER=y
CONFIG_CMD_BDINFO_EXTRA=y
CONFIG_CMD_HISTORY=y
CONFIG_CMD_BOOTZ=y
# CONFIG_BOOTM_NETBSD is not set
CONFIG_CMD_BOOTMENU=y
CONFIG_CMD_ASKENV=y
CONFIG_CMD_GREPENV=y
CONFIG_CMD_ERASEENV=y
CONFIG_CMD_ENV_CALLBACK=y
CONFIG_CMD_ENV_FLAGS=y
CONFIG_CMD_NVEDIT_INDIRECT=y
CONFIG_CMD_NVEDIT_INFO=y
CONFIG_CMD_BINOP=y
CONFIG_CRC32_VERIFY=y
CONFIG_CMD_MD5SUM=y
CONFIG_MD5SUM_VERIFY=y
CONFIG_CMD_MEMINFO=y
CONFIG_CMD_MEMINFO_MAP=y
CONFIG_CMD_MEM_SEARCH=y
CONFIG_CMD_SHA1SUM=y
CONFIG_SHA1SUM_VERIFY=y
CONFIG_CMD_STRINGS=y
# CONFIG_CMD_DM is not set
CONFIG_CMD_GPIO=y
CONFIG_CMD_GPIO_READ=y
CONFIG_CMD_MTD=y
# CONFIG_CMD_PINMUX is not set
# CONFIG_CMD_SF is not set
CONFIG_CMD_SETEXPR_FMT=y
CONFIG_CMD_TFTPPUT=y
CONFIG_CMD_TFTPSRV=y
CONFIG_CMD_DHCP=y
CONFIG_CMD_PING=y
CONFIG_CMD_WGET=y
CONFIG_CMD_CLS=y
CONFIG_CMD_PAUSE=y
# CONFIG_ISO_PARTITION is not set
CONFIG_OF_SPL_REMOVE_PROPS="pinctrl-0 pinctrl-names clocks clock-names interrupt-parent interrupts resets reset-names"
CONFIG_ENV_OVERWRITE=y
CONFIG_ENV_IS_IN_SPI_FLASH=y
CONFIG_ENV_SECT_SIZE_AUTO=y
CONFIG_ENV_RELOC_GD_ENV_ADDR=y
CONFIG_ENV_USE_DEFAULT_ENV_TEXT_FILE=y
CONFIG_ENV_DEFAULT_ENV_TEXT_FILE="defenvs/phicomm_k2.env"
CONFIG_NETCONSOLE=y
CONFIG_NET_RANDOM_ETHADDR=y
CONFIG_SPL_DM=y
# CONFIG_SIMPLE_BUS is not set
# CONFIG_SPL_SIMPLE_BUS is not set
# CONFIG_OF_TRANSLATE is not set
CONFIG_BUTTON_GPIO=y
CONFIG_GPIO_HOG=y
CONFIG_LED_GPIO=y
CONFIG_DM_MTD=y
CONFIG_SPI_FLASH_BAR=y
CONFIG_SPI_FLASH_EON=y
CONFIG_SPI_FLASH_GIGADEVICE=y
CONFIG_SPI_FLASH_MACRONIX=y
CONFIG_SPI_FLASH_WINBOND=y
CONFIG_SPI_FLASH_XMC=y
CONFIG_SPI_FLASH_MTD=y
CONFIG_MT7620_ETH=y
CONFIG_SPECIFY_CONSOLE_INDEX=y
CONFIG_SERIAL_RX_BUFFER=y
CONFIG_DEBUG_UART_SHIFT=2
CONFIG_SPI=y
CONFIG_MT7620_SPI=y
CONFIG_SYSRESET=y
CONFIG_SYSRESET_RESETCTL=y
# CONFIG_REGEX is not set
# CONFIG_SHA256 is not set
CONFIG_LZ4=y
CONFIG_LZMA=y
CONFIG_LZO=y
CONFIG_SPL_LZMA=y
CONFIG_SPL_LZMA_SIZE_OPTIMIZATION=y
# CONFIG_TOOLS_LIBCRYPTO is not set
# CONFIG_TOOLS_KWBIMAGE is not set
```

## configs/mt7621_raisecom_msg1500-x-00_defconfig
```kconfig
CONFIG_MIPS=y
CONFIG_SYS_HAS_NONCACHED_MEMORY=y
CONFIG_SYS_MALLOC_LEN=0x100000
CONFIG_SPL_LIBCOMMON_SUPPORT=y
CONFIG_SPL_LIBGENERIC_SUPPORT=y
CONFIG_NR_DRAM_BANKS=1
CONFIG_ENV_SIZE=0x020000
CONFIG_ENV_OFFSET=0x0c0000
CONFIG_DEFAULT_DEVICE_TREE="mt7621_raisecom_msg1500-x-00"
CONFIG_SPL_SERIAL=y
CONFIG_SPL_SYS_MALLOC_F_LEN=0x100000
CONFIG_SPL_BSS_START_ADDR=0x80140000
CONFIG_SPL_BSS_MAX_SIZE=0x80000
CONFIG_SYS_BOOTM_LEN=0x08000000
CONFIG_SYS_LOAD_ADDR=0x87000000
CONFIG_SPL=y
CONFIG_DEBUG_UART_BASE=0xbe000c00
CONFIG_DEBUG_UART_CLOCK=50000000
CONFIG_ARCH_MTMIPS=y
CONFIG_SOC_MT7621=y
CONFIG_MT7621_BOOT_FROM_NAND=y
CONFIG_BOARD_MT7621_GENERIC=y
CONFIG_SYS_MIPS_TIMER_FREQ=440000000
# CONFIG_MIPS_CACHE_SETUP is not set
# CONFIG_MIPS_CACHE_DISABLE is not set
CONFIG_RESTORE_EXCEPTION_VECTOR_BASE=y
CONFIG_MIPS_BOOT_FDT=y
CONFIG_DEBUG_UART=y
# CONFIG_LOCALVERSION_AUTO is not set
CONFIG_STACK_SIZE=0x100000
CONFIG_TIMESTAMP=y
CONFIG_BUTTON_BOOTSTRAP=y
CONFIG_FIT=y
CONFIG_BOOTDELAY=1
CONFIG_AUTOBOOT_MENU_SHOW=y
# CONFIG_ARCH_FIXUP_FDT_MEMORY is not set
CONFIG_SYS_MALLOC_BOOTPARAMS=y
CONFIG_SPL_MAX_SIZE=0x20000
CONFIG_SPL_SYS_MALLOC_SIMPLE=y
CONFIG_SPL_NAND_SUPPORT=y
CONFIG_SPL_NAND_BASE=y
CONFIG_SPL_NAND_IDENT=y
CONFIG_HUSH_PARSER=y
CONFIG_CMD_BDINFO_EXTRA=y
CONFIG_CMD_HISTORY=y
CONFIG_CMD_BOOTZ=y
# CONFIG_BOOTM_NETBSD is not set
CONFIG_CMD_BOOTMENU=y
CONFIG_CMD_ASKENV=y
CONFIG_CMD_GREPENV=y
CONFIG_CMD_ERASEENV=y
CONFIG_CMD_ENV_CALLBACK=y
CONFIG_CMD_ENV_FLAGS=y
CONFIG_CMD_NVEDIT_INDIRECT=y
CONFIG_CMD_NVEDIT_INFO=y
CONFIG_CMD_BINOP=y
CONFIG_CRC32_VERIFY=y
CONFIG_CMD_MD5SUM=y
CONFIG_MD5SUM_VERIFY=y
CONFIG_CMD_MEMINFO=y
CONFIG_CMD_MEMINFO_MAP=y
CONFIG_CMD_MEM_SEARCH=y
CONFIG_CMD_SHA1SUM=y
CONFIG_SHA1SUM_VERIFY=y
CONFIG_CMD_STRINGS=y
# CONFIG_CMD_DM is not set
CONFIG_CMD_GPIO=y
CONFIG_CMD_GPIO_READ=y
CONFIG_CMD_MTD=y
CONFIG_CMD_MTD_MARKBAD=y
CONFIG_CMD_MTD_NAND_WRITE_TEST=y
CONFIG_CMD_MTD_NAND_READ_TEST=y
CONFIG_CMD_NAND_TRIMFFS=y
CONFIG_CMD_NAND_LOCK_UNLOCK=y
CONFIG_CMD_NAND_TORTURE=y
CONFIG_CMD_NAND_WATCH=y
# CONFIG_CMD_PINMUX is not set
CONFIG_CMD_READ=y
CONFIG_CMD_WRITE=y
CONFIG_CMD_SETEXPR_FMT=y
CONFIG_CMD_TFTPPUT=y
CONFIG_CMD_TFTPSRV=y
CONFIG_CMD_DHCP=y
CONFIG_CMD_PING=y
CONFIG_CMD_WGET=y
CONFIG_CMD_CLS=y
CONFIG_CMD_PAUSE=y
CONFIG_CMD_FS_GENERIC=y
CONFIG_CMD_MTDPARTS=y
CONFIG_CMD_MTDPARTS_SPREAD=y
CONFIG_CMD_MTDPARTS_SHOW_NET_SIZES=y
CONFIG_MTDIDS_DEFAULT="nand0=nand.0"
CONFIG_MTDPARTS_DEFAULT="mtdparts=nand.0:512k(u-boot),256k(u-boot-env),256k(env),256k(factory),-(ubi)"
CONFIG_CMD_UBI=y
CONFIG_CMD_UBI_RENAME=y
# CONFIG_ISO_PARTITION is not set
CONFIG_ENV_OVERWRITE=y
CONFIG_ENV_IS_IN_NAND=y
CONFIG_ENV_RANGE=0x040000
CONFIG_ENV_RELOC_GD_ENV_ADDR=y
CONFIG_ENV_USE_DEFAULT_ENV_TEXT_FILE=y
CONFIG_ENV_DEFAULT_ENV_TEXT_FILE="defenvs/raisecom_msg1500-x-00.env"
CONFIG_NETCONSOLE=y
CONFIG_NET_RANDOM_ETHADDR=y
# CONFIG_SIMPLE_BUS is not set
# CONFIG_OF_TRANSLATE is not set
CONFIG_BUTTON_GPIO=y
CONFIG_GPIO_HOG=y
CONFIG_LED_GPIO=y
CONFIG_DM_MTD=y
CONFIG_MTD_RAW_NAND=y
CONFIG_NAND_MT7621=y
CONFIG_SYS_NAND_ONFI_DETECTION=y
CONFIG_SYS_NAND_U_BOOT_LOCATIONS=y
CONFIG_SYS_NAND_U_BOOT_OFFS=0x0
CONFIG_UBI_SILENCE_MSG=y
CONFIG_MTD_UBI_FASTMAP=y
CONFIG_MEDIATEK_ETH=y
CONFIG_SERIAL_RX_BUFFER=y
CONFIG_DEBUG_UART_SHIFT=2
CONFIG_SYSRESET=y
CONFIG_SYSRESET_RESETCTL=y
CONFIG_UBIFS_SILENCE_MSG=y
# CONFIG_REGEX is not set
# CONFIG_SHA256 is not set
CONFIG_LZ4=y
CONFIG_LZMA=y
CONFIG_SPL_LZMA=y
CONFIG_SPL_LZMA_SIZE_OPTIMIZATION=y
CONFIG_HEXDUMP=y
# CONFIG_TOOLS_LIBCRYPTO is not set
# CONFIG_TOOLS_KWBIMAGE is not set
```

## configs/mt7981_jcg_q30-pro-256m_defconfig
```kconfig
CONFIG_ARM=y
CONFIG_SYS_HAS_NONCACHED_MEMORY=y
CONFIG_POSITION_INDEPENDENT=y
CONFIG_ARCH_MEDIATEK=y
CONFIG_TEXT_BASE=0x41e00000
CONFIG_SYS_MALLOC_F_LEN=0x4000
CONFIG_NR_DRAM_BANKS=1
CONFIG_ENV_SIZE=0x20000
CONFIG_ENV_OFFSET=0x0
CONFIG_DEFAULT_DEVICE_TREE="mt7981_jcg_q30-pro-256m"
CONFIG_OF_LIBFDT_OVERLAY=y
CONFIG_TARGET_MT7981=y
CONFIG_SYS_LOAD_ADDR=0x43100000
CONFIG_DEBUG_UART_BASE=0x11002000
CONFIG_DEBUG_UART_CLOCK=40000000
CONFIG_DEBUG_UART=y
# CONFIG_LOCALVERSION_AUTO is not set
CONFIG_TIMESTAMP=y
CONFIG_BUTTON_BOOTSTRAP=y
CONFIG_FIT=y
CONFIG_BOOTDELAY=1
CONFIG_AUTOBOOT_MENU_SHOW=y
# CONFIG_BOARD_INIT is not set
CONFIG_SYS_MALLOC_BOOTPARAMS=y
CONFIG_HUSH_PARSER=y
CONFIG_CMD_BDINFO_EXTRA=y
CONFIG_CMD_HISTORY=y
CONFIG_CMD_BOOTZ=y
# CONFIG_BOOTM_NETBSD is not set
CONFIG_CMD_BOOTMENU=y
CONFIG_CMD_ASKENV=y
CONFIG_CMD_GREPENV=y
CONFIG_CMD_ERASEENV=y
CONFIG_CMD_ENV_CALLBACK=y
CONFIG_CMD_ENV_FLAGS=y
CONFIG_CMD_NVEDIT_INDIRECT=y
CONFIG_CMD_NVEDIT_INFO=y
CONFIG_CMD_BINOP=y
CONFIG_CRC32_VERIFY=y
CONFIG_CMD_MD5SUM=y
CONFIG_MD5SUM_VERIFY=y
CONFIG_CMD_MEMINFO=y
CONFIG_CMD_MEMINFO_MAP=y
CONFIG_CMD_MEM_SEARCH=y
CONFIG_CMD_SHA1SUM=y
CONFIG_SHA1SUM_VERIFY=y
CONFIG_CMD_STRINGS=y
CONFIG_CMD_GPIO=y
CONFIG_CMD_GPIO_READ=y
CONFIG_CMD_MTD=y
CONFIG_CMD_MTD_OTP=y
CONFIG_CMD_MTD_MARKBAD=y
CONFIG_CMD_MTD_NAND_WRITE_TEST=y
CONFIG_CMD_MTD_NAND_READ_TEST=y
CONFIG_CMD_READ=y
CONFIG_CMD_WRITE=y
CONFIG_CMD_SETEXPR_FMT=y
CONFIG_CMD_TFTPPUT=y
CONFIG_CMD_TFTPSRV=y
CONFIG_CMD_DHCP=y
CONFIG_CMD_PING=y
CONFIG_CMD_WGET=y
CONFIG_CMD_CLS=y
CONFIG_CMD_PAUSE=y
CONFIG_CMD_PSTORE=y
CONFIG_CMD_PSTORE_MEM_ADDR=0x42ff0000
CONFIG_CMD_PSTORE_RECORD_SIZE=0x2000
CONFIG_CMD_PSTORE_CONSOLE_SIZE=0x8000
CONFIG_CMD_PSTORE_FTRACE_SIZE=0x0
CONFIG_CMD_PSTORE_PMSG_SIZE=0x0
CONFIG_CMD_HASH=y
CONFIG_HASH_VERIFY=y
CONFIG_CMD_FS_GENERIC=y
CONFIG_CMD_UBI=y
CONFIG_CMD_UBI_RENAME=y
CONFIG_ENV_OVERWRITE=y
CONFIG_ENV_IS_IN_MTD=y
CONFIG_ENV_RELOC_GD_ENV_ADDR=y
CONFIG_ENV_MTD_DEV="env"
CONFIG_ENV_USE_DEFAULT_ENV_TEXT_FILE=y
CONFIG_ENV_DEFAULT_ENV_TEXT_FILE="defenvs/jcg_q30-pro-256m.env"
CONFIG_NETCONSOLE=y
CONFIG_NET_RANDOM_ETHADDR=y
CONFIG_REGMAP=y
CONFIG_SYSCON=y
CONFIG_BUTTON_GPIO=y
CONFIG_CLK=y
CONFIG_GPIO_HOG=y
CONFIG_LED_GPIO=y
# CONFIG_MMC is not set
CONFIG_MTD=y
CONFIG_DM_MTD=y
CONFIG_MTD_SPI_NAND=y
CONFIG_UBI_SILENCE_MSG=y
CONFIG_MTD_UBI_FASTMAP=y
CONFIG_MEDIATEK_ETH=y
# CONFIG_MTK_ETH_SWITCH_AN8855 is not set
CONFIG_PINCTRL=y
CONFIG_PINCONF=y
CONFIG_PINCTRL_MT7981=y
CONFIG_DM_SERIAL=y
CONFIG_SERIAL_RX_BUFFER=y
CONFIG_MTK_SERIAL=y
CONFIG_SPI=y
CONFIG_DM_SPI=y
CONFIG_MTK_SPIM=y
CONFIG_UBIFS_SILENCE_MSG=y
CONFIG_BZIP2=y
CONFIG_ZSTD=y
# CONFIG_TOOLS_LIBCRYPTO is not set
# CONFIG_TOOLS_KWBIMAGE is not set
```

## configs/mt7981_siluo_sl-3000_defconfig
```kconfig
CONFIG_ARM=y
CONFIG_SYS_HAS_NONCACHED_MEMORY=y
CONFIG_POSITION_INDEPENDENT=y
CONFIG_ARCH_MEDIATEK=y
CONFIG_TEXT_BASE=0x41e00000
CONFIG_SYS_MALLOC_F_LEN=0x4000
CONFIG_NR_DRAM_BANKS=1
CONFIG_ENV_SIZE=0x10000
CONFIG_ENV_OFFSET=0x0
CONFIG_DEFAULT_DEVICE_TREE="mt7981_siluo_sl-3000"
CONFIG_OF_LIBFDT_OVERLAY=y
CONFIG_TARGET_MT7981=y
CONFIG_SYS_LOAD_ADDR=0x50000000
CONFIG_DEBUG_UART_BASE=0x11002000
CONFIG_DEBUG_UART_CLOCK=40000000
CONFIG_DEBUG_UART=y
# CONFIG_LOCALVERSION_AUTO is not set
# CONFIG_EFI_LOADER is not set
CONFIG_TIMESTAMP=y
CONFIG_BUTTON_BOOTSTRAP=y
CONFIG_FIT=y
# CONFIG_BOOTSTD is not set
CONFIG_BOOTDELAY=1
CONFIG_AUTOBOOT_MENU_SHOW=y
# CONFIG_BOARD_INIT is not set
CONFIG_SYS_MALLOC_BOOTPARAMS=y
CONFIG_HUSH_PARSER=y
CONFIG_CMD_BDINFO_EXTRA=y
CONFIG_CMD_HISTORY=y
CONFIG_CMD_BOOTZ=y
# CONFIG_BOOTM_NETBSD is not set
CONFIG_CMD_BOOTMENU=y
CONFIG_CMD_ASKENV=y
CONFIG_CMD_GREPENV=y
CONFIG_CMD_ERASEENV=y
CONFIG_CMD_ENV_CALLBACK=y
CONFIG_CMD_ENV_FLAGS=y
CONFIG_CMD_NVEDIT_INDIRECT=y
CONFIG_CMD_NVEDIT_INFO=y
CONFIG_CMD_BINOP=y
CONFIG_CRC32_VERIFY=y
CONFIG_CMD_MD5SUM=y
CONFIG_MD5SUM_VERIFY=y
CONFIG_CMD_MEMINFO=y
CONFIG_CMD_MEMINFO_MAP=y
CONFIG_CMD_MEM_SEARCH=y
CONFIG_CMD_SHA1SUM=y
CONFIG_SHA1SUM_VERIFY=y
CONFIG_CMD_STRINGS=y
CONFIG_CMD_GPIO=y
CONFIG_CMD_GPIO_READ=y
CONFIG_CMD_GPT=y
CONFIG_CMD_GPT_RENAME=y
CONFIG_CMD_LSBLK=y
CONFIG_CMD_MMC=y
CONFIG_CMD_BKOPS_ENABLE=y
CONFIG_CMD_MMC_REG=y
CONFIG_MMC_SPEED_MODE_SET=y
CONFIG_CMD_MTD=y
CONFIG_CMD_PART=y
CONFIG_CMD_READ=y
CONFIG_CMD_WRITE=y
CONFIG_CMD_SETEXPR_FMT=y
CONFIG_CMD_TFTPPUT=y
CONFIG_CMD_TFTPSRV=y
CONFIG_CMD_DHCP=y
CONFIG_CMD_PING=y
CONFIG_CMD_WGET=y
CONFIG_CMD_CLS=y
CONFIG_CMD_PAUSE=y
CONFIG_CMD_PSTORE=y
CONFIG_CMD_PSTORE_MEM_ADDR=0x42ff0000
CONFIG_CMD_PSTORE_RECORD_SIZE=0x2000
CONFIG_CMD_PSTORE_CONSOLE_SIZE=0x8000
CONFIG_CMD_PSTORE_FTRACE_SIZE=0x0
CONFIG_CMD_PSTORE_PMSG_SIZE=0x0
CONFIG_CMD_HASH=y
CONFIG_HASH_VERIFY=y
CONFIG_PARTITION_TYPE_GUID=y
CONFIG_ENV_OVERWRITE=y
CONFIG_ENV_IS_IN_MTD=y
CONFIG_ENV_RELOC_GD_ENV_ADDR=y
CONFIG_ENV_MTD_DEV="env"
CONFIG_ENV_USE_DEFAULT_ENV_TEXT_FILE=y
CONFIG_ENV_DEFAULT_ENV_TEXT_FILE="defenvs/siluo_sl-3000.env"
CONFIG_NETCONSOLE=y
CONFIG_NET_RANDOM_ETHADDR=y
CONFIG_REGMAP=y
CONFIG_SYSCON=y
CONFIG_BUTTON_GPIO=y
CONFIG_CLK=y
CONFIG_GPIO_HOG=y
CONFIG_LED_GPIO=y
CONFIG_MMC_MTK=y
CONFIG_MTD=y
CONFIG_DM_MTD=y
CONFIG_DM_SPI_FLASH=y
CONFIG_SPI_FLASH_SFDP_SUPPORT=y
CONFIG_SPI_FLASH_BOYAMICRO=y
CONFIG_SPI_FLASH_EON=y
CONFIG_SPI_FLASH_GIGADEVICE=y
CONFIG_SPI_FLASH_MACRONIX=y
CONFIG_SPI_FLASH_WINBOND=y
CONFIG_SPI_FLASH_XMC=y
# CONFIG_SPI_FLASH_USE_4K_SECTORS is not set
CONFIG_SPI_FLASH_MTD=y
CONFIG_MEDIATEK_ETH=y
# CONFIG_MTK_ETH_SWITCH_AN8855 is not set
CONFIG_PINCTRL=y
CONFIG_PINCONF=y
CONFIG_PINCTRL_MT7981=y
CONFIG_DM_REGULATOR=y
CONFIG_DM_REGULATOR_FIXED=y
CONFIG_DM_SERIAL=y
CONFIG_SERIAL_RX_BUFFER=y
CONFIG_MTK_SERIAL=y
CONFIG_SPI=y
CONFIG_DM_SPI=y
CONFIG_MTK_SPIM=y
CONFIG_LZO=y
CONFIG_BZIP2=y
CONFIG_ZSTD=y
CONFIG_HEXDUMP=y
# CONFIG_TOOLS_LIBCRYPTO is not set
# CONFIG_TOOLS_KWBIMAGE is not set
```
